## arch/arm/mach-rk3188/Kconfig
```kconfig
choice
	prompt "Rockchip SoC Type"
	depends on ARCH_RK3188

config SOC_RK3188
	bool "RK3188"
	select USB_ARCH_HAS_EHCI if USB_SUPPORT

config SOC_RK3188M
	bool "RK3188M"
	select USB_ARCH_HAS_EHCI if USB_SUPPORT

endchoice

choice
	prompt "RK3188 Board Type"
	depends on SOC_RK3188

config MACH_RK3188_TB
	bool "RK3188 Top Board"

config MACH_RK3188_SDK
	bool "RK3188 sdk Board"

config MACH_RK3188_FPGA
	bool "RK3188 FPGA board"
	select RK_FPGA

config MACH_RK3188_LR097
        bool "RK3188 LR097 JC21CA board"

config MACH_RK3188_DS1006H
	bool "RK3188 ds1006h board"
        
config MACH_RK3188_FAC
        bool "RK3188 Board for factory"
        select MACH_RK_FAC

endchoice

config RK3188T_FREQ
		bool "RK3188T Freq Table?"
        depends on SOC_RK3188
        default n
		help
		  RK3188T 'safe' frequencies selected

config RK3188T_DDR_OVERRIDE
		bool "RK3188T DDR override?"
        depends on SOC_RK3188
        default n
		help
		  RK3188T PLL frequency cap ignored

config RK3188T_GPU_OVERRIDE
		bool "RK3188T GPU override?"
        depends on SOC_RK3188
        default n
		help
		  RK3188T PLL frequency cap ignored
```

## drivers/video/rockchip/hdmi/Kconfig
```kconfig
menuconfig RK_HDMI
       bool "Rockchip HDMI support"
       select FB_MODE_HELPERS
       
if RK_HDMI
source "drivers/video/rockchip/hdmi/chips/Kconfig"
endif

config RK_HDMI_DEBUG
		bool "Rockchip HDMI Debugging"
        depends on RK_HDMI
        default n
		help
		  Enableds verbose debugging the the HDMI drivers

config RK_HDMI_CTL_CODEC
		bool "Mute Codec When HDMI Actived"
		depends on RK_HDMI
		default n
		help
			If you say y heres, Codec will be mute when hdmi inserted,
			and unmute when removed. 

choice HDMI_VIDEO
                bool "Desktop resolution"
                depends on RK_HDMI
		default HDMI_1920
config HDMI_1920
		bool "1920x1080"
		depends on RK_HDMI
config HDMI_1280
		bool "1280x720"
		depends on RK_HDMI
endchoice
```
